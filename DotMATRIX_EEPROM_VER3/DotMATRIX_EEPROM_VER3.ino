/*
 * 포함된 라이브러리
 - 파일에 포함된 MaxMatrix.zip파일을 아래의 경로를 통해 추가
 스케치 > 라이브러리 포함하기 > .ZIP라이브러리 추가 > 열기
 */

#include <EEPROM.h> //EEPROM 라이브러리
#include <MaxMatrix.h>
#include <SoftwareSerial.h>
#include <avr/pgmspace.h>


PROGMEM const unsigned char CH[] = {
  3, 8, B00000000, B00000000, B00000000, B00000000, B00000000, // space
  1, 8, B01011111, B00000000, B00000000, B00000000, B00000000, // !
  3, 8, B00000011, B00000000, B00000011, B00000000, B00000000, // "
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  4, 8, B00001000, B00000100, B00001000, B00000100, B00000000, // ~ 
};

void write_String(int addrs, String source) //문자열 WRITING
{
  int stringSize = source.length(); //문자열 길이
  for(int i=0;i<100;i++)
  {
    EEPROM.write(addrs+i, source[i]); //문자열을 롬에 저장
  }
  EEPROM.write(addrs + stringSize,'\0'); //문자열 맨 뒤에 공백 저장 (끝을 구분)
}

String read_String(int addrs)
{
  char source[100]; //Max 100 Bytes
  int leng=0; 
  unsigned char _char; //임시 CHAR
  while(_char != '\0' && leng < 100) //공백이 오고(끝) Max(100)에 도달하였을때 반복문 탈출
  {
    _char = EEPROM.read(addrs + leng); //임시 CHAR에 롬에 저장된 전체 배열 중에서 [addrs]로부터 [leng]번 떨어진 문자 저장
    source[leng] = _char; //그것을 다시 리턴할 문자열에 저장
    leng++;
  }
  source[leng]='\0';  //마지막에 공백문자 추가(없을 경우 문자가 서로 이어져서 출력됨
  return String(source);
}

bool butState(){
  int state = digitalRead(10);
  Serial.println(state);
  return state;
}

/*
 아두이노 MAX7219포트 설정 (GND / VCC는 5V)
 포트는 회로 구성의 여건에 따라 변경 가능합니다.
 */
int dIn = 7;                                     // DIN 포트
int clk = 3;                                     // CLK 포트
int cs = 4;                                      // CS 포트
int maxInUse = 4;                                // 도트매트릭스 사용 개수

int butVal, butPast = 2, matrixState;
/*
 * 도트매트릭스 초기 출력 설정 (부분 수정 가능)
   수정 가능 사항 : scrollSpeed, text, brightness
 */
MaxMatrix m(dIn, cs, clk, maxInUse);
SoftwareSerial Bluetooth(8, 9);                   // 블루투스 연결 (RX - 9, TX - 8)
byte buffer[10];
char incomebyte;
int scrollSpeed;                            // 처음 시작할때 전광판 속도
String lastWords = read_String(0);
char text[100] = "";             
int brightness;
int count = 0;
char indicator; // 변수이름 수정하지 말것


void setup() {
  m.init();
  m.setIntensity(brightness);                      // 처음 시작할때 밝기
  Bluetooth.begin(9600);                           // 블루투스 모듈 속도 (블루투스 모델에 따라 변경 가능)
  Serial.begin(9600); 
  for(int i= 0; i < 100; i++){
    text[i] = lastWords[i];
  }
  m.setIntensity(EEPROM.read(103)); //기존에 저장된 밝기 불러옴
  scrollSpeed = EEPROM.read(102); //기존에 저장된 스크롤 속도 불러옴
}


void loop() {
  butVal = butState();
  if(butVal != butPast){
    if(butVal == 1)
      matrixState = 0;
    else
      matrixState = 1;
  }
  butPast = butVal;

  if(matrixState == 1)
    printStringWithShift(text, scrollSpeed);          // 텍스트 출력// 텍스트 출력
  else
    m.clear();
  
    
  if (Bluetooth.available()) {                      // 시리얼 포트에서 데이터값이 오는지 확인
    indicator = Bluetooth.read();                   // 블루투스 시리얼 포트 읽기 시작
    
   Serial.println(indicator);
    /*
       보내기 버튼 클릭시 전에 있던 텍스트 지우기
     - 앱인벤터에서 보내기 버튼 클릭시 '1' 보내기
     */
    if (indicator == '1') {
      
      for (int i = 0; i < 100; i++) {
        text[i] = 0;
        m.clear();
      }
      write_String(0, text); //초기화된 문자 저장 (똑같이 초기화)
      
      // 핸드폰에서 오는 모든 데이터값(문자열)을 읽고 텍스트 배열에 넣기
      while (Bluetooth.available()) {
        incomebyte = Bluetooth.read();
        text[count] = incomebyte;
        count++;
      }
      count = 0;
      write_String(0, text); //들여온 문자 저장
      Bluetooth.write('1');
    }
    
      /*
     스크롤바로 전광판 속도 조절
     -앱인벤터에서 텍스트 '2' 보내면 섬네일 위치에 따라 값조정
     */ 
    else if (indicator == '2') {
      String sS = Bluetooth.readString();
      scrollSpeed = 100 - sS.toInt();                // (100~150) 변경가능, 밀리세컨드, 값이 낮을수록 속도가 빨라짐
      EEPROM.write(102, scrollSpeed); //스크롤 속도 저장
      Bluetooth.write('1');
    }

      /*
     스크롤바로 전광판 밝기 조절
     -앱인벤터에서 텍스트 '3' 보내면 섬네일 위치에 따라 값조정
     */

    else if (indicator == '3') {
      String sB = Bluetooth.readString();
      brightness = sB.toInt();
      EEPROM.write(103, brightness); //밝기 저장
      m.setIntensity(brightness);
      Bluetooth.write('1');
    }

    else if (indicator == '4') {
      matrixState = 0;
      Bluetooth.write('1');
    }

    else if (indicator == '5') {
      matrixState = 1;
      Bluetooth.write('1');
    }
  }
}


/*
 문자 배열을 사용하여 스크롤 텍스트를 정의하고 반복 부분에서 printStringWithShift함수는
 두번째 인수와 밀리 초 단위로 정의 된 스크롤 속도로 LED에 텍스트를 출력합니다.

 printStringWithShift 함수는 입력받은 텍스트 문자열에서 추출한 문자를
 LED에 스크롤문자로 출력하는 것입니다

 for문과 반복문을 사용하여 문자가 다음에 출력될 위치를 계산합니다.
 */
void printCharWithShift(char c, int shift_speed) {
  if (c < 32) return;
  c -= 32;
  memcpy_P(buffer, CH + 7 * c, 7);
  m.writeSprite(32, 0, buffer);
  m.setColumn(32 + buffer[0], 0);
  for (int i = 0; i < buffer[0] + 1; i++)
  {
    delay(shift_speed);
    m.shiftLeft(false, false);
  }
}
void printStringWithShift(char* s, int shift_speed) {
  while (*s != 0) {
    printCharWithShift(*s, shift_speed);
    s++;
  }
}
void printString(char* s)
{
  int col = 0;
  while (*s != 0)
  {
    if (*s < 32) continue;
    char c = *s - 32;
    memcpy_P(buffer, CH + 7 * c, 7);
    m.writeSprite(col, 0, buffer);
    m.setColumn(col + buffer[0], 0);
    col += buffer[0] + 1;
    s++;
  }
}
